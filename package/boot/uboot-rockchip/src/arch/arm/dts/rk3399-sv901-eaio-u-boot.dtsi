// SPDX-License-Identifier: GPL-2.0-or-later

#include "rk3399-u-boot.dtsi"
#include "rk3399-sdram-lpddr4-100.dtsi"

/ {
	chosen {
		u-boot,spl-boot-order = "same-as-spl", &sdhci;
	};
};

&vdd_log {
	regulator-init-microvolt = <950000>;
};
