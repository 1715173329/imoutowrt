## package/boot/uboot-rk3588/src/board/rockchip/nanopi6/Kconfig
```kconfig
if TARGET_NANOPI6

config SYS_BOARD
	default "nanopi6"

config SYS_VENDOR
	default "rockchip"

config SYS_CONFIG_NAME
	default "nanopi6"

config BOARD_SPECIFIC_OPTIONS
	def_bool y

endif
```
